## firmware/esp32-idf/main/Kconfig.projbuild
```kconfig
menu "Yugoef ESP32 CSI Configuration"

    config WIFI_SSID
        string "WiFi SSID"
        default "MyWiFi"
        help
            SSID (network name) to connect to.

    config WIFI_PASSWORD
        string "WiFi Password"
        default "MyPassword"
        help
            WiFi password (WPA/WPA2).

    config YUGOEF_UDP_HOST
        string "Yugoef UDP Backend Host"
        default "100.119.129.28"
        help
            IPv4 address of the Yugoef backend UDP receiver.
            Default points to the Alibaba/Tailscale backend. ESP32 must be on a network that can route to this address.

    config YUGOEF_UDP_PORT
        int "Yugoef UDP Backend Port"
        default 5005
        help
            UDP port used by Yugoef CSI ingestion.

    config YUGOEF_NODE_ID
        int "Yugoef numeric node ID"
        default 1
        range 1 65535
        help
            Numeric node ID encoded into the protocol v1 header.

    config YUGOEF_ROOM_ID
        int "Yugoef numeric room ID"
        default 1
        range 0 65535
        help
            Numeric room ID encoded into the protocol v1 header.

    config YUGOEF_WIFI_CHANNEL
        int "Expected WiFi channel"
        default 6
        range 1 14
        help
            Channel metadata fallback used for heartbeat and hello packets.
            RAW_CSI packets use rx_ctrl.channel from ESP-IDF.

    config CSI_MAX_PACKET_SIZE
        int "CSI max packet size"
        default 1400
        range 128 1500
        help
            Must match backend CSI_MAX_PACKET_SIZE. Backend default is 1400.

    config HEARTBEAT_INTERVAL_MS
        int "Heartbeat interval milliseconds"
        default 5000
        range 1000 60000
        help
            Interval for HEARTBEAT protocol packets.

endmenu
```

## firmware/esp32-idf/sdkconfig.defaults
```kconfig
CONFIG_WIFI_SSID="MyWiFi"
CONFIG_WIFI_PASSWORD="MyPassword"
CONFIG_YUGOEF_UDP_HOST="127.0.0.1"
CONFIG_YUGOEF_UDP_PORT=5005
CONFIG_YUGOEF_NODE_ID=1
CONFIG_YUGOEF_ROOM_ID=1
CONFIG_YUGOEF_WIFI_CHANNEL=6
CONFIG_CSI_MAX_PACKET_SIZE=1400
CONFIG_HEARTBEAT_INTERVAL_MS=5000
```
